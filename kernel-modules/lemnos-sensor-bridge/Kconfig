## kernel-modules/lemnos-sensor-bridge/Kconfig
```kconfig
# SPDX-License-Identifier: GPL-2.0
config VIDEO_LEMNOS_SENSOR_BRIDGE
	tristate "Lemnos sensor bridge (camera sensor driven from userspace)"
	depends on OF && I2C && VIDEO_DEV
	select MEDIA_CONTROLLER
	select VIDEO_V4L2_SUBDEV_API
	select V4L2_FWNODE
	help
	  A generic V4L2 sensor subdevice for camera sensors that are driven
	  from userspace over i2c-dev (Lemnos). It describes the CSI-2 link to
	  the receiver and forwards stream start/stop to userspace.

	  To compile this driver as a module, choose M here: the module will
	  be called lemnos_sensor_bridge.
```

## kernel/Kconfig
```kconfig
# SPDX-License-Identifier: GPL-2.0
#
# For a kernel tree. Put this directory in as drivers/misc/lemnos/, then add
#   source "drivers/misc/lemnos/Kconfig"
# to drivers/misc/Kconfig and
#   obj-$(CONFIG_LEMNOS) += lemnos/
# to drivers/misc/Makefile. docs/kernel-config.md has the full list of symbols.

config LEMNOS
	tristate "Lemnos hardware engine kernel module"
	depends on PM && OF && HAS_DMA && COMMON_CLK && DMA_SHARED_BUFFER
	depends on I2C && SPI_MASTER && GPIOLIB && PWM && REGULATOR && THERMAL && RESET_CONTROLLER
	depends on !CPU_BIG_ENDIAN
	help
	  The kernel side of the Lemnos engine: claims on I2C, SPI, GPIO and PWM, DMA buffers,
	  register and interrupt access for a block in user space, clocks, supplies and resets,
	  frame streams, and the blocks the module drives itself. Loaded or built in only when a
	  board needs it: without it the daemon uses the kernel's stock interfaces.

	  If you say M here, the module is lemnos.ko. Say Y to build it into the kernel, which an
	  image without loadable modules needs; then CONFIG_RP1_PIO must be Y too if the RP1 PIO
	  part is wanted.
```
